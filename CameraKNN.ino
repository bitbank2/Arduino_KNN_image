/*
  Camera KNN

  Captures downsampled images and streams them over serial to be viewed in cameraKNN.html

  Import example image data from index.html and the Arduino sketch will recognise the objects

*/

#include <Arduino_OV767X.h>
#include <Arduino_KNN.h>

const int HEIGHT = 240;
const int WIDTH = 320;
const int BLOCK_SIZE = 20; // downsampling factor = 20x smaller
const int INPUT_SIZE = 3 * (WIDTH / BLOCK_SIZE) * (HEIGHT / BLOCK_SIZE);

// Replace this section with image data arrays from cameraKNN.html
///////////////////////////////////////////////////////////////////

const int input_size = 3 * 16 * 12;
KNNClassifier myKNN(input_size);
const int number_examples = 15;
const int example_classes[] = {0,0,0,0,0,1,1,1,1,1,2,2,2,2,2};
const char* classes[] = {"Orange","Apple","Kumquat"};
const float example_images[][input_size] =
{
{0xcb,0xff,0xff,0xdf,0xff,0xff,0xe1,0xff,0xff,0xea,0xff,0xff,0xed,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0xff,0xff},
{0xc5,0xff,0xff,0xd8,0xff,0xff,0xe0,0xff,0xff,0xe4,0xff,0xff,0xe9,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0xff,0xff},
{0xdd,0xff,0xff,0xf8,0xff,0xff,0xfe,0xff,0xff,0xff,0xff,0xff,0xff,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0xff,0xff},
{0xc9,0xff,0xff,0xdb,0xff,0xff,0xe4,0xff,0xff,0xe8,0xff,0xff,0xeb,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0x71,0x00},
{0xc3,0x92,0x0e,0xd6,0x73,0x00,0xcb,0x60,0x00,0xc0,0x51,0x00,0xc3,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0xff,0xff},
{0xee,0xff,0xff,0xff,0xff,0xff,0xff,0xff,0xff,0xff,0xff,0xff,0xff,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0xff,0xff},
{0xc9,0xfa,0xdf,0xff,0xff,0xff,0xff,0xff,0xff,0xff,0xff,0xff,0xff,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0xff,0xff},
{0xf6,0xff,0xff,0xff,0xff,0xff,0xff,0xff,0xff,0xff,0xff,0xff,0xff,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0xff,0xff},
{0xf6,0xff,0xff,0xff,0xff,0xff,0xff,0xff,0xff,0xff,0xff,0xff,0xff,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0xff,0xff},
{0xb8,0xcf,0xaa,0xeb,0xfc,0xfc,0xff,0xff,0xff,0xff,0xff,0xff,0xff,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0xff,0xff},
{0xf5,0xff,0xfa,0xff,0xff,0xff,0xff,0xff,0xff,0xff,0xff,0xff,0xff,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0xff,0xff},
{0xf2,0xff,0xff,0xff,0xff,0xff,0xff,0xff,0xff,0xff,0xff,0xff,0xff,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0xff,0xff},
{0xff,0xff,0xff,0xff,0xff,0xff,0xff,0xff,0xff,0xff,0xff,0xff,0xff,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0xff,0xff},
{0xfb,0xff,0xff,0xff,0xff,0xff,0xff,0xff,0xff,0xff,0xff,0xff,0xff,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0xff,0xff},
{0xfe,0xff,0xff,0xff,0xff,0xff,0xff,0xff,0xff,0xff,0xff,0xff,0xff,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0xff,0xff}
};

///////////////////////////////////////////////////////////////////
// End section

KNNClassifier myKNN(input_size);
float input[input_size];

const int bytesPerFrame = HEIGHT * WIDTH * 2;
byte input_image[HEIGHT * WIDTH * 2];
unsigned long timer;

void setup() {
  Serial.begin(9600);
  while (!Serial);

  if (!Camera.begin(QVGA, RGB565, 1)) {
    Serial.println("Failed to initialize camera!");
    while (1);
  }

  // Add KNN examples
  for (int i = 0; i < number_examples; i++) {
    myKNN.addExample(example_images[i], example_classes[i]);
  }
}

void loop() {

  Camera.readFrame(input_image); // get raw image data from camera
  
  // destination image data
  unsigned short output_image[HEIGHT / BLOCK_SIZE][WIDTH / BLOCK_SIZE][3] = { 0 };
  
  // get max value to normalize with
  unsigned short pixel_max = 0;
  unsigned short pixel_min = 255 * 255;

  for (int i = 0; i < bytesPerFrame; i += 2) {

    // Convert from RGB565 to 24-bit RGB
    byte high = input_image[i];
    byte low  = input_image[i + 1];
    unsigned short pixel = (high << 8) | low;

    byte red =   (pixel & 0b1111100000000000) >> 11;
    byte green = (pixel & 0b0000011111100000) >> 6; // lose 1 bit
    byte blue =  (pixel & 0b0000000000011111);

    // Downsample
    int j = i / 2;
    unsigned short x = j % WIDTH;
    unsigned short y = floor(j / WIDTH);
    byte block_x = floor(x / BLOCK_SIZE);
    byte block_y = floor(y / BLOCK_SIZE);

    output_image[block_y][block_x][0] += red;
    output_image[block_y][block_x][1] += green;
    output_image[block_y][block_x][2] += blue;

  }

  // Scan pixel value ranges for normalization
  for (int y = 0; y < HEIGHT / BLOCK_SIZE; y++) {
    for (int x = 0; x < WIDTH / BLOCK_SIZE; x++) {
      for (int c = 0; c < 3; c++) {
        pixel_max = max(pixel_max, output_image[y][x][c]);
        pixel_min = min(pixel_min, output_image[y][x][c]);
      }
    }
  }

  Serial.print("Image starts: ");
  Serial.print(WIDTH / BLOCK_SIZE);
  Serial.print(",");
  Serial.print(HEIGHT / BLOCK_SIZE);
  Serial.print(",");
  Serial.println("RGB");

  int inputPtr = 0;

  // Output to serial viewer
  for (int y = 0; y < HEIGHT / BLOCK_SIZE; y++) {
    for (int x = 0; x < WIDTH / BLOCK_SIZE; x++) {
      Serial.print("p ");
      for (int c = 0; c < 3; c++) {
        // normalize values
        int p = map(output_image[y][x][c], pixel_min, pixel_max, 0, 360);
        if (p > 255) {
          p = 255;
        }
        Serial.print(p);
        // Put normalized pixel in the KNN classifier input array
        input[inputPtr++] = p;
        Serial.print(",");
      }
      Serial.println("");
    }
  }

  if (number_examples > 0) {
    // Output KNN object classification result
    int classification = myKNN.classify(input, 1);
    Serial.print("Classification: ");
    Serial.println(class_labels[classification]);
  }
}
