/*
  Image KNN
*/

#include <Arduino_OV767X.h>
#include <Arduino_KNN.h>

///////////////////////////////////////////////////////////////////
const int input_size = 3 * 10 * 8;
KNNClassifier myKNN(input_size);
const int number_examples = 12;
const char* class_labels[] = {"Apple","Ginger beer","None","Raspberry Pi"};
const int example_classes[] = {0,0,0,0,1,1,1,1,2,2,2,2};
const float example_images[][input_size] =
{
{0xe1,0xff,0xf5,0xf8,0xff,0xff,0xff,0xff,0xff,0xf8,0xff,0xff,0xff,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0xff,0xff},
{0xec,0xff,0xff,0xff,0xff,0xff,0xff,0xff,0xff,0xff,0xff,0xff,0xff,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0xff,0xff},
{0xe1,0xff,0xfc,0xf7,0xff,0xff,0xff,0xff,0xff,0xff,0xff,0xff,0xff,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0xff,0xff},
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{0x0c,0x79,0x1c,0x4f,0x72,0x67,0x62,0x93,0x89,0x7b,0xa0,0x93,0x8a,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0xe1,0xbb},
};

///////////////////////////////////////////////////////////////////

unsigned long timer;
const bool DEBUG = false;
const int HEIGHT = 240;
const int WIDTH = 320;
const int BLOCK_SIZE = 30;
float input[input_size];
const int bytesPerFrame = HEIGHT * WIDTH * 2;
byte camdata[HEIGHT * WIDTH * 2]; // QVGA: 320x240 X 2 bytes per pixel (RGB565)

void setup() {
  Serial.begin(9600);
  while (!Serial);

  if (!Camera.begin(QVGA, RGB565, 1)) {
    Serial.println("Failed to initialize camera!");
    while (1);
  }

// Add KNN examples
  for (size_t i = 0; i < number_examples; i++) {
      myKNN.addExample(example_images[i], example_classes[i]);
}



  // Optionally, enable the test pattern for testing
  // Camera.testPattern();
}

void loop() {

  Camera.readFrame(camdata);

  const int frame_height = HEIGHT / BLOCK_SIZE;
  const int frame_width = WIDTH / BLOCK_SIZE;

  // get max value to normalize with
  uint16_t col_max[3] = {0};
  uint16_t col_min[3] = {255 * 255};

  uint16_t rgb_frame[frame_height][frame_width][3] = { 0 };
  
  uint16_t *u16Cam = (uint16_t *)camdata;
  uint16_t rSum, gSum, bSum;
 
  for (uint16_t y = 0; y <frame_height; y++) {
     for (uint16_t x = 0; x < frame_width; x++) {
        rSum = gSum = bSum = 0; // start the counters for this block
        for (int j=0; j<BLOCK_SIZE; j++) {
           uint16_t *pPixels = &u16Cam[(j * WIDTH) + (y * WIDTH * BLOCK_SIZE) + (x * BLOCK_SIZE)];
           for (int i=0; i<BLOCK_SIZE; i++) {
              uint16_t pixel = __builtin_bswap16(*pPixels++);
              rSum += ((pixel & 0xf800) >> 11);
              gSum += ((pixel & 0x07e0) >> 5);
              bSum += (pixel & 0x1f);
           } // for i
        } // for j
        rgb_frame[y][x][0] = rSum;
        rgb_frame[y][x][1] = gSum;
        rgb_frame[y][x][2] = bSum;
     } // for x
  } // for y

#ifdef OLD_WAY
  for (size_t i = 0; i < bytesPerFrame; i += 2) {

    // Convert from RGB565 to 24-bit RGB
    const uint8_t high = camdata[i];
    const uint8_t low  = camdata[i + 1];
    const uint16_t pixel = (high << 8) | low;
    const uint8_t red =   (pixel & 0b1111100000000000) >> 11;
    const uint8_t green = (pixel & 0b0000011111100000) >> 6;
    const uint8_t blue =  (pixel & 0b0000000000011111);

    // Downsample
    const size_t j = i / 2;
    const uint16_t x = j % WIDTH;
    const uint16_t y = floor(j / WIDTH);
    const uint8_t block_x = floor(x / BLOCK_SIZE);
    const uint8_t block_y = floor(y / BLOCK_SIZE);

    rgb_frame[block_y][block_x][0] += red;
    rgb_frame[block_y][block_x][1] += green;
    rgb_frame[block_y][block_x][2] += blue;

  }
#endif // OLD_WAY

  // Get normalization range (start at 1 because issues with lhs of image)
  for (int y = 0; y < HEIGHT / BLOCK_SIZE; y++) {
    for (int x = 1; x < WIDTH / BLOCK_SIZE; x++) {
      for (int c = 0; c < 3; c++) {
        col_max[0] = max(col_max[0], rgb_frame[y][x][c]);
        col_min[0] = min(col_min[0], rgb_frame[y][x][c]);
      }
    }
  }

  Serial.print("Image starts: ");
  Serial.print(WIDTH / BLOCK_SIZE);
  Serial.print(",");
  Serial.print(HEIGHT / BLOCK_SIZE);
  Serial.print(",");
  Serial.println("RGB");

  int inputPtr = 0;

  // Output to serial viewer
  for (int y = 0; y < HEIGHT / BLOCK_SIZE; y++) {
    for (int x = 0; x < WIDTH / BLOCK_SIZE; x++) {
      Serial.print("p ");
      for (int c = 0; c < 3; c++) {
        int p = map(rgb_frame[y][x][c], col_min[0], col_max[0], 0, 360);
        if (p > 255) {
          p = 255;
        }
        Serial.print(p);
        input[inputPtr++] = p;
        Serial.print(",");
      }
      Serial.println("");
    }
  }

  Serial.print("Time: ");
  timer = micros();
  int classification = myKNN.classify(input, 1); // classify input with K=3
  Serial.println(micros() - timer); //prints time since program started


  float confidence = myKNN.confidence();
  // print the classification and confidence
  Serial.print("Classification: ");
  Serial.println(class_labels[classification]);

  // since there are 2 examples close to the input and K = 3,
  // expect the confidence to be: 2/3 = ~0.67
  Serial.print("Confidence: ");
  Serial.println(confidence);

}
